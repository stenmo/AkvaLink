## config/sdkconfig.defaults.sensor
```kconfig
# AkvaLink sensor-only test variant — read the connected sensor and log it.
# No Matter, no BLE, no networking. For verifying probe wiring / the sensor.
#
#   akvalink.cmd --sensor --rebuild
#
# build.sh passes -DAKVALINK_NO_MATTER=1 so the root CMakeLists skips the whole
# esp-matter stack (otherwise its NetworkCommissioning static_assert fails when
# no Thread/Wi-Fi transport is enabled).

CONFIG_AKVALINK_SENSOR_TEST=y

# Strip every radio stack — this is a bare sensor read.
CONFIG_OPENTHREAD_ENABLED=n
CONFIG_OPENTHREAD_MTD=n
CONFIG_ENABLE_WIFI_STATION=n
CONFIG_ENABLE_CHIPOBLE=n
CONFIG_BT_ENABLED=n
CONFIG_BT_NIMBLE_ENABLED=n
```

## main/Kconfig.projbuild
```kconfig
menu "AkvaLink"

    config AKVALINK_BLE_ONLY
        bool "Build the standalone BLE-only variant (no Matter)"
        default n
        help
            Build the --ble AkvaLink variant: skip Matter/Thread/Wi-Fi and
            run a standalone NimBLE GATT server (Device Information, Environmental
            Sensing temperature, and a custom AkvaLink service with uptime).

            Use this for homes with no Matter hub and no Wi-Fi — a phone/app
            connects directly over BLE. Select via the launcher's --ble flag
            (which layers sdkconfig.defaults.ble on top of sdkconfig.defaults).

    config AKVALINK_BLE_PM
        bool "Enable BLE light sleep (experimental — validate with PPK2 first)"
        depends on AKVALINK_BLE_ONLY
        default n
        help
            Enable CPU/peripheral light sleep and BLE controller sleep for the
            --ble variant. Requires CONFIG_BT_LE_SLEEP_ENABLE, CONFIG_MAC_BB_PD,
            and CONFIG_BT_LE_LP_CLK_SRC_DEFAULT to also be set (see the
            commented-out block at the bottom of sdkconfig.defaults.ble).
            Do NOT enable until current consumption has been measured and the
            numbers look correct on the PPK2 with J3 in series.

    config AKVALINK_SENSOR_TEST
        bool "Build the sensor-only test variant (no Matter, no BLE)"
        default n
        help
            Build the --sensor test variant: skip Matter and BLE entirely
            and just read the sensor (DS18B20) over 1-Wire, logging the
            temperature. Use it to verify probe wiring and the sensor before
            building the full app.

    config AKVALINK_AP
        bool "Build the Wi-Fi AP variant (SoftAP + web page, no Matter/BLE)"
        default n
        help
            Build the --ap AkvaLink variant: run an OPEN Wi-Fi SoftAP named
            "AkvaLink" hosting a captive web page that shows the live DS18B20
            temperature. No Matter, no BLE, no home network — any phone or
            laptop joins the AP and the page opens.

            NOTE: an always-on SoftAP keeps the Wi-Fi radio awake and is NOT
            battery friendly (days, not years) — for mains/USB-powered use.
            Select via the launcher's --ap flag.

    config AKVALINK_ESPNOW
        bool "Build the standalone ESP-NOW broadcast variant (deep sleep, no hub)"
        default n
        help
            Build the --espnow AkvaLink variant: wake from deep sleep, read the
            DS18B20, broadcast one akvalink_espnow_payload_t packet via ESP-NOW
            to FF:FF:FF:FF:FF:FF, then go back to deep sleep. No Matter, no BLE,
            no provisioning. Friends' ESP32 devices on the same channel receive
            the reading without any pairing.
            Sleep interval: CONFIG_AKVALINK_ESPNOW_SLEEP_S (default 60 s).
            Channel: CONFIG_AKVALINK_ESPNOW_CHANNEL (default 1).

    config AKVALINK_ESPNOW_CHANNEL
        int "ESP-NOW Wi-Fi channel (1-13, must match receivers)"
        depends on AKVALINK_ESPNOW
        default 1
        range 1 13
        help
            All ESP-NOW senders and receivers must be on the same channel.
            Default 1 is the safest choice for compatibility with receivers
            that default to channel 1.

    config AKVALINK_ESPNOW_SLEEP_S
        int "Deep sleep interval between ESP-NOW broadcasts (seconds)"
        depends on AKVALINK_ESPNOW
        default 60
        range 5 3600
        help
            How long the device sleeps between temperature readings and
            broadcasts. 60 s is a good default — 300 s gives the best battery
            life at the cost of slower update rate on receivers.

    config AKVALINK_STATION
        bool "Build the Wi-Fi station variant (BLE-provisioned client, no Matter)"
        default n
        help
            Build the --station AkvaLink variant: join the home Wi-Fi as a
            client, provisioned over BLE with Espressif Unified Provisioning
            (the free "ESP BLE Provisioning" app). Once online it advertises
            mDNS "akvalink.local" and serves the temperature page. No Matter,
            no hub — the phone/app talks to it directly on the LAN.

            NOTE: staying associated keeps the Wi-Fi radio reachable — lighter
            than the SoftAP variant but still not multi-year on a coin cell.
            Select via the launcher's --station flag.

    config AKVALINK_MQTT_BROKER_URL
        string "MQTT broker URL for Home Assistant autodiscovery"
        depends on AKVALINK_STATION
        default "mqtt://homeassistant.local:1883"
        help
            The MQTT broker the station variant connects to for publishing
            Home Assistant MQTT autodiscovery config and live temperature
            readings. Defaults to the Mosquitto add-on address on a standard
            Home Assistant install (homeassistant.local:1883). Change if your
            broker runs on a different host, port, or scheme (e.g.
            mqtt://192.168.1.10:1883 or mqtts://... for TLS).

    config AKVALINK_BLE_ESCAPE_HATCH
        bool "BLE escape hatch (hold GPIO9 at boot to enter minimal BLE mode)"
        default y if AKVALINK_AP
        default n
        depends on BT_ENABLED && !AKVALINK_BLE_ONLY && !AKVALINK_STATION
        help
            When GPIO9 (BOOT button on EVK) is held at power-on, skip the
            configured network stack and start a minimal BLE GATT server
            instead (ESS Temperature 0x181A + DIS 0x180A, legacy 1M adv).

            Useful for recovery when the main transport is unavailable, for
            demo without a Thread border router, or as a universal "is it
            alive?" diagnostic. Connects with any BLE temperature app.

            AP: enabled by default (BLE is explicitly compiled into this
            variant; the Wi-Fi SoftAP can't be reached if provisioning fails).
            Thread/WiFi: disabled by default — the BLE stack is already
            compiled in (CHIPoBLE commissioning) so the incremental flash cost
            is only ~15 KB (dead-stripped when disabled). Enable if flash
            headroom allows — 40 KB headroom is enough for a thread build.

    # ---- BLE GATT tuning ----------------------------------------------------
    # These apply to the --ble variant and the GPIO9 escape-hatch BLE mode in
    # --station.  They are ignored by Matter / Thread / Wi-Fi builds.

    config AKVALINK_BLE_CODED_PHY
        bool "Enable Coded PHY S=8 rotating advertising (long-range mode)"
        depends on BT_NIMBLE_EXT_ADV
        default n
        help
            When enabled the device alternates between legacy 1M advertising
            and Coded PHY S=8 every AKVALINK_BLE_ADV_ROTATE_MS milliseconds.
            Coded PHY provides ~2-4x range at the expense of slightly slower
            discovery on legacy scanners.

            Requires CONFIG_BT_NIMBLE_EXT_ADV=y and
            CONFIG_BT_NIMBLE_MAX_EXT_ADV_INSTANCES>=2.

    config AKVALINK_BLE_ADV_ITVL_MS
        int "BLE advertising interval (ms)"
        depends on BT_ENABLED
        default 200
        range 20 10000
        help
            Advertising interval while unconnected.  200 ms is the BT SIG
            "general discoverable" sweet spot — snappy enough to find quickly,
            light enough on the battery.  Increase (e.g. 1000 ms) to further
            reduce radio wake-ups at the cost of slower discovery.

    config AKVALINK_BLE_ADV_ROTATE_MS
        int "Coded PHY advertising dwell time per PHY (ms)"
        depends on AKVALINK_BLE_CODED_PHY
        default 4000
        range 500 30000
        help
            How long to advertise on each PHY (1M then Coded) before switching.
            Only active when AKVALINK_BLE_CODED_PHY is enabled.

endmenu
```

## sdkconfig.defaults.ap
```kconfig
# AkvaLink Wi-Fi AP variant (--ap) — open SoftAP "AkvaLink" + captive web page.
#
# Layer on top of the base defaults:
#   idf.py -DSDKCONFIG_DEFAULTS="sdkconfig.defaults;sdkconfig.defaults.ap" reconfigure
# or via the launcher:  launch-akvalink-wsl.cmd --ap --rebuild
#
# NO Matter, NO BLE, NO home network. Any phone/laptop joins the open "AkvaLink"
# Wi-Fi and a captive page shows the live temperature. See main/ap_web.cpp.
#
# POWER: an always-on SoftAP keeps the Wi-Fi radio awake — this variant is NOT
# battery friendly (days, not years). Intended for mains/USB power, so the
# aggressive light-sleep from the base defaults is turned OFF below.

# Select the AP app path (main/Kconfig.projbuild).
CONFIG_AKVALINK_AP=y

# No Matter network stacks.
CONFIG_OPENTHREAD_ENABLED=n
CONFIG_OPENTHREAD_MTD=n
CONFIG_OPENTHREAD_SRP_CLIENT=n
CONFIG_OPENTHREAD_DNS_CLIENT=n
CONFIG_OPENTHREAD_JOINER=n

# No BLE — this variant is Wi-Fi SoftAP only.
CONFIG_BT_ENABLED=n
CONFIG_BT_NIMBLE_ENABLED=n
CONFIG_ENABLE_CHIPOBLE=n

# Wi-Fi: SoftAP on; station off (the device hosts its own network).
CONFIG_ESP_WIFI_SOFTAP_SUPPORT=y
CONFIG_ENABLE_WIFI_STATION=n

# HTTP server needs more LWIP sockets than the Thread-tuned base (8): httpd uses
# a listen + control socket + several client sockets, and the captive DNS task
# needs one more. With only 8, httpd_start() fails and no page is served.
CONFIG_LWIP_MAX_SOCKETS=16

# --- BLE escape hatch: hold GPIO9 at boot to skip Wi-Fi AP and enter BLE mode.
# AP has ~1 MB flash headroom — adding the full BLE stack (NimBLE) is trivial.
# Minimal GATT server: DIS + ESS temperature. No OTA, no custom service.
CONFIG_BT_ENABLED=y
CONFIG_BT_NIMBLE_ENABLED=y
CONFIG_BT_NIMBLE_EXT_ADV=n          # legacy adv only — ble_escape.cpp uses ble_gap_adv_start()
CONFIG_BT_NIMBLE_MAX_CONNECTIONS=1
CONFIG_BT_NIMBLE_ROLE_CENTRAL=n
CONFIG_BT_NIMBLE_ROLE_OBSERVER=n
CONFIG_BT_NIMBLE_NVS_PERSIST=n
CONFIG_BT_NIMBLE_LOG_LEVEL_WARNING=y
CONFIG_AKVALINK_BLE_ESCAPE_HATCH=y  # enabled by default for AP

# POWER: an AP must stay awake to beacon + serve clients, so disable the light
# sleep / power management the base enables for the Thread SED.
CONFIG_PM_ENABLE=n
CONFIG_FREERTOS_USE_TICKLESS_IDLE=n
CONFIG_ESP_SLEEP_POWER_DOWN_FLASH=n
CONFIG_PM_POWER_DOWN_CPU_IN_LIGHT_SLEEP=n
CONFIG_PM_POWER_DOWN_PERIPHERAL_IN_LIGHT_SLEEP=n
```

## sdkconfig.defaults.ble
```kconfig
# AkvaLink BLE-only variant — standalone NimBLE GATT server, no Matter.
#
# Layer on top of the base defaults:
#   idf.py -DSDKCONFIG_DEFAULTS="sdkconfig.defaults;sdkconfig.defaults.ble" reconfigure
# or via the launcher:  launch-akvalink-wsl.cmd --ble --rebuild
#
# For homes with no Matter hub and no Wi-Fi: a phone/app connects directly over
# BLE and reads device info + live temperature. See main/ble_gatt.cpp.

# Select the BLE-only app path (main/Kconfig.projbuild).
CONFIG_AKVALINK_BLE_ONLY=y

# No Matter network stacks — BLE only.
CONFIG_OPENTHREAD_ENABLED=n
CONFIG_OPENTHREAD_MTD=n
CONFIG_OPENTHREAD_SRP_CLIENT=n
CONFIG_OPENTHREAD_DNS_CLIENT=n
CONFIG_OPENTHREAD_JOINER=n
CONFIG_ENABLE_WIFI_STATION=n

# We own the NimBLE host directly (not via Matter's CHIPoBLE commissioning).
CONFIG_ENABLE_CHIPOBLE=n

# Keep BLE / NimBLE enabled.
CONFIG_BT_ENABLED=y
CONFIG_BT_NIMBLE_ENABLED=y

# --- BLE light sleep (DISABLED — validate with PPK2 before enabling) --------
# Set CONFIG_AKVALINK_BLE_PM=y in this file AND uncomment the three lines
# below once the measurement wiring is solid and the numbers look right.
# All three are required together — the IDF BLE controller hard-errors
# at compile time if BT_LE_SLEEP_ENABLE=y without MAC_BB_PD=y, and
# BT_LE_LP_CLK_SRC_DEFAULT is needed so the radio runs off the RTC slow
# clock (not the main XTAL, which is powered down in light sleep).
#
# CONFIG_AKVALINK_BLE_PM=y
# CONFIG_BT_LE_SLEEP_ENABLE=y
# CONFIG_BT_LE_LP_CLK_SRC_DEFAULT=y
# CONFIG_MAC_BB_PD=y

# Max ATT MTU — bigger GATT writes mean fewer round-trips, so faster BLE OTA.
# Chrome / modern phones negotiate up to 517; the peripheral advertises this and
# the link settles on min(peer, 517). Pairs with 2M PHY (set on connect in
# ble_gatt.cpp) for the best firmware-update throughput.
CONFIG_BT_NIMBLE_ATT_PREFERRED_MTU=517

# Extended advertising — REQUIRED for Coded PHY (long range). The GATT server
# rotates two advertising instances: legacy 1M (phone-friendly) + Coded S=8
# (long range). Needs at least 2 instances.
CONFIG_BT_NIMBLE_EXT_ADV=y
CONFIG_BT_NIMBLE_MAX_EXT_ADV_INSTANCES=1

# NOTE: esp-matter is NOT compiled into this variant — build.sh sets
# AKVALINK_NO_MATTER, so the root CMakeLists builds a plain ESP-IDF project
# (no esp_matter/chip/openthread requires). Only NimBLE + the sensor link in.
```

## sdkconfig.defaults.espnow
```kconfig
# AkvaLink ESP-NOW variant — deep-sleep broadcast sensor, no hub, no provisioning.
#
# Layer on top of the base defaults:
#   idf.py -DSDKCONFIG_DEFAULTS="sdkconfig.defaults;sdkconfig.defaults.espnow" reconfigure
# or via the launcher:  launch-akvalink-wsl.cmd --espnow --rebuild
#
# One reading per wake cycle → broadcast via ESP-NOW → deep sleep N seconds.
# Receivers (friends' ESP32 devices) listen on the same channel and parse the
# akvalink_espnow_payload_t struct (version, temp, battery_mv, seq, mac).
#
# POWER: deep sleep floor ≈ 7 µA (NORA-W40 datasheet). Active window ≈ 200 ms
# per cycle. Measure with PPK2 via J3 for the real average current.

# Select the ESP-NOW app path (main/Kconfig.projbuild).
CONFIG_AKVALINK_ESPNOW=y

# No Matter network stacks.
CONFIG_OPENTHREAD_ENABLED=n
CONFIG_OPENTHREAD_MTD=n
CONFIG_OPENTHREAD_SRP_CLIENT=n
CONFIG_OPENTHREAD_DNS_CLIENT=n
CONFIG_OPENTHREAD_JOINER=n
CONFIG_OPENTHREAD_DEVICE_TYPE_SLEEPY_END_DEVICE=n

# No BLE — ESP-NOW uses Wi-Fi PHY only.
CONFIG_BT_ENABLED=n
CONFIG_BT_NIMBLE_ENABLED=n
CONFIG_ENABLE_CHIPOBLE=n

# Wi-Fi: STA mode (no AP, no SoftAP). ESP-NOW requires Wi-Fi to be started
# but never actually associates with a network.
CONFIG_ENABLE_WIFI_STATION=n
CONFIG_ESP_WIFI_SOFTAP_SUPPORT=n

# Power management: base sdkconfig enables light sleep for the Thread SED.
# For the ESP-NOW variant we use deep sleep between cycles instead — the device
# fully powers down the CPU+radio and wakes via the RTC timer. Disable the
# light sleep PM to avoid it conflicting with esp_deep_sleep().
CONFIG_PM_ENABLE=n
CONFIG_FREERTOS_USE_TICKLESS_IDLE=n
CONFIG_ESP_SLEEP_POWER_DOWN_FLASH=n
CONFIG_PM_POWER_DOWN_CPU_IN_LIGHT_SLEEP=n
CONFIG_PM_POWER_DOWN_PERIPHERAL_IN_LIGHT_SLEEP=n
```

## sdkconfig.defaults.sensor
```kconfig
# AquaLink sensor-only test variant — read the connected sensor and log it.
# No Matter, no BLE, no networking. For verifying probe wiring / the sensor.
#
#   launch-aqualink-wsl.cmd --sensor-only --rebuild
#
# build.sh passes -DAQUALINK_NO_MATTER=1 so the root CMakeLists skips the whole
# esp-matter stack (otherwise its NetworkCommissioning static_assert fails when
# no Thread/Wi-Fi transport is enabled).

CONFIG_AQUALINK_SENSOR_TEST=y

# Strip every radio stack — this is a bare sensor read.
CONFIG_OPENTHREAD_ENABLED=n
CONFIG_OPENTHREAD_MTD=n
CONFIG_ENABLE_WIFI_STATION=n
CONFIG_ENABLE_CHIPOBLE=n
CONFIG_BT_ENABLED=n
CONFIG_BT_NIMBLE_ENABLED=n
```
